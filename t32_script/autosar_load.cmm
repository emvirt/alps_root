y.SPATH.t "\home\htkim\arndale\LET-V_u-boot\autosar20_wobsw" "Z:\arndale\LET-V_u-boot\autosar20_wobsw"
data.load.elf Z:\arndale\LET-V_u-boot\autosar20_wobsw\autosar20.elf /nocode
;data.load.binary Z:\arndale\LET-V_u-boot\autosar20_wobsw\autosar20.bin 0x41000000
R.S PC 0x41004a60 /CORE 0. 


;y.SPATH.t "\home\htkim\TCAD\autosar20_wobsw" "Z:\TCAD\autosar20_wobsw"
;data.load.elf Z:\TCAD\autosar20_wobsw\autosar20.elf
;data.load.binary Z:\arndale\LET-V_u-boot\autosar20_wobsw\autosar20.bin 0x41000000
;R.S PC 0x41004a60 /CORE 0. 