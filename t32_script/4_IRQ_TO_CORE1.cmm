D.S A:0x0:0x10481800--0x1048189F %LE %LONG 0x02020202